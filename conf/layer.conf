## conf/layer.conf
```bitbake
# We have a conf and classes directory, add to BBPATH
BBPATH .= ":${LAYERDIR}"

# We have recipes-* directories, add to BBFILES
BBFILES += "${LAYERDIR}/recipes-*/*/*.bb \
            ${LAYERDIR}/recipes-*/*/*.bbappend"

BBFILE_COLLECTIONS += "meta-beagleros"
BBFILE_PATTERN_meta-beagleros = "^${LAYERDIR}/"
BBFILE_PRIORITY_meta-beagleros = "6"

LAYERDEPENDS_meta-beagleros = "core"
LAYERSERIES_COMPAT_meta-beagleros = "honister"
```
